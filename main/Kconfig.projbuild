## main/Kconfig.projbuild
```kconfig
# put here your custom config value
menu "Example Configuration"
config ESP_WIFI_SSID
    string "WiFi SSID"
    default "myssid"
    help
	SSID (network name) for the example to connect to.

config ESP_WIFI_PASSWORD
    string "WiFi Password"
    default "mypassword"
    help
	WiFi password (WPA or WPA2) for the example to use.
endmenu

menu "Ultrasonic configuration"
config US_PIN_TRIGGER
	int "Pin connected to Trigger on Ultrasonic module"
	default 14
config US_PIN_ECHO
	int "Pin connected to Echo on Ultrasonic module"
	default 12
endmenu

menu "Leds configuration"
config LEDS_STRIP_LENGTH
	int "How many pixels in your led strip"
	default 4
endmenu
```
